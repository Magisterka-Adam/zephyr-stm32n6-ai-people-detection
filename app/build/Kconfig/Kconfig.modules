## app/build/Kconfig/Kconfig.modules
```kconfig
menu "zephyr-stm32-mw-isp (/home/a.paleczny/stm_workspace/st/lib/zephyr-stm32-mw-isp)"
osource "/home/a.paleczny/stm_workspace/st/lib/zephyr-stm32-mw-isp/Kconfig"
config ZEPHYR_ZEPHYR_STM32_MW_ISP_MODULE
	bool
	default y
endmenu
menu "cmsis-dsp (/home/a.paleczny/stm_workspace/modules/lib/cmsis-dsp)"
osource "$(ZEPHYR_CMSIS_DSP_KCONFIG)"
config ZEPHYR_CMSIS_DSP_MODULE
	bool
	default y
endmenu
menu "cmsis_6 (/home/a.paleczny/stm_workspace/modules/hal/cmsis_6)"
osource "$(ZEPHYR_CMSIS_6_KCONFIG)"
config ZEPHYR_CMSIS_6_MODULE
	bool
	default y
endmenu
config ZEPHYR_HAL_STM32_MODULE
	bool
	default y

config ZEPHYR_HAL_STM32_MODULE_BLOBS
	bool
menu "lvgl (/home/a.paleczny/stm_workspace/modules/lib/gui/lvgl)"
osource "/home/a.paleczny/stm_workspace/modules/lib/gui/lvgl/zephyr/Kconfig"
config ZEPHYR_LVGL_MODULE
	bool
	default y
endmenu
menu "mbedtls (/home/a.paleczny/stm_workspace/modules/crypto/mbedtls)"
osource "$(ZEPHYR_MBEDTLS_KCONFIG)"
config ZEPHYR_MBEDTLS_MODULE
	bool
	default y
endmenu
config ZEPHYR_MCUBOOT_MODULE
	bool
	default y
```

## app/build/Kconfig/Kconfig.sysbuild.modules
```kconfig
config ZEPHYR_ZEPHYR_STM32_MW_ISP_MODULE
   bool
   default y
config ZEPHYR_CMSIS_DSP_MODULE
   bool
   default y
config ZEPHYR_CMSIS_6_MODULE
   bool
   default y
config ZEPHYR_HAL_STM32_MODULE
   bool
   default y
config ZEPHYR_LVGL_MODULE
   bool
   default y
config ZEPHYR_MBEDTLS_MODULE
   bool
   default y
config ZEPHYR_MCUBOOT_MODULE
   bool
   default y
```

## app/build/Kconfig/arch/Kconfig
```kconfig
# Load Zephyr Arch Kconfig descriptions.
osource "/home/a.paleczny/stm_workspace/zephyr/arch/rx/Kconfig"
osource "/home/a.paleczny/stm_workspace/zephyr/arch/x86/Kconfig"
osource "/home/a.paleczny/stm_workspace/zephyr/arch/xtensa/Kconfig"
osource "/home/a.paleczny/stm_workspace/zephyr/arch/sparc/Kconfig"
osource "/home/a.paleczny/stm_workspace/zephyr/arch/riscv/Kconfig"
osource "/home/a.paleczny/stm_workspace/zephyr/arch/posix/Kconfig"
osource "/home/a.paleczny/stm_workspace/zephyr/arch/mips/Kconfig"
osource "/home/a.paleczny/stm_workspace/zephyr/arch/arm64/Kconfig"
osource "/home/a.paleczny/stm_workspace/zephyr/arch/arm/Kconfig"
osource "/home/a.paleczny/stm_workspace/zephyr/arch/arc/Kconfig"
```

## build/Kconfig/boards/Kconfig
```kconfig
# Load Zephyr board Kconfig descriptions.
osource "/home/a.paleczny/stm_workspace/zephyr/boards/st/stm32n6570_dk/Kconfig"
```

## build/app/Kconfig/boards/Kconfig.defconfig
```kconfig
# Load Zephyr board defconfig descriptions.
osource "/home/a.paleczny/stm_workspace/zephyr/boards/st/stm32n6570_dk/Kconfig.defconfig"
```

## build/mcuboot/Kconfig/boards/Kconfig.stm32n6570_dk
```kconfig
# Load board Kconfig descriptions.
osource "/home/a.paleczny/stm_workspace/zephyr/boards/st/stm32n6570_dk/Kconfig.stm32n6570_dk"
```

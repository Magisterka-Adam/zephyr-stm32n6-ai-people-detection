## CMakeLists.txt
```
##############################################################################
# @file    CMakeLists.txt
# @author  GPM Application Team
#
##############################################################################
# @attention
#
# Copyright (c) 2025 STMicroelectronics.
# All rights reserved.
#
# This software is licensed under terms that can be found in the LICENSE file
# in the root directory of this software component.
# If no LICENSE file comes with this software, it is provided AS-IS.
#
##############################################################################

cmake_minimum_required(VERSION 3.20.0)

set(BOARD stm32n6570_dk)
set(SHIELD st_b_cams_imx_mb1854)

find_package(Zephyr REQUIRED HINTS $ENV{ZEPHYR_BASE})

project(app LANGUAGES C)

target_include_directories(app PRIVATE inc Model)
target_sources(app PRIVATE src/main.c src/model.c src/utils.c Model/network.c)

# lib_vision_models_pp
target_include_directories(app PRIVATE ../Lib/lib_vision_models_pp/lib_vision_models_pp/Inc
                           ../Lib/lib_vision_models_pp/Drivers/CMSIS/DSP/Include)

target_sources(app PRIVATE ../Lib/lib_vision_models_pp/lib_vision_models_pp/Src/vision_models_pp.c
                           ../Lib/lib_vision_models_pp/lib_vision_models_pp/Src/vision_models_pp_maxi_if32.c
                           ../Lib/lib_vision_models_pp/lib_vision_models_pp/Src/vision_models_pp_maxi_is8.c
                           ../Lib/lib_vision_models_pp/lib_vision_models_pp/Src/vision_models_pp_maxi_iu8.c
                           ../Lib/lib_vision_models_pp/lib_vision_models_pp/Src/od_pp_yolov2.c
                           ../Lib/lib_vision_models_pp/lib_vision_models_pp/Src/od_pp_yolov5.c
                           ../Lib/lib_vision_models_pp/lib_vision_models_pp/Src/od_pp_yolov8.c
                           ../Lib/lib_vision_models_pp/lib_vision_models_pp/Src/od_pp_st_yolox.c
                           ../Lib/ai-postprocessing-wrapper/app_postprocess_od_yolov8_ui.c
                           )

# AI_Runtime
target_compile_definitions(app PRIVATE LL_ATON_PLATFORM=LL_ATON_PLAT_STM32N6
                           LL_ATON_OSAL=LL_ATON_OSAL_ZEPHYR
                           LL_ATON_RT_MODE=LL_ATON_RT_ASYNC
                           LL_ATON_SW_FALLBACK
                           LL_ATON_DBG_BUFFER_INFO_EXCLUDED=1
                           APP_HAS_PARALLEL_NETWORKS=0)

target_include_directories(app PRIVATE ../Lib/AI_Runtime/Inc ../Lib/ai-postprocessing-wrapper/
                           ../Lib/AI_Runtime/Npu/ll_aton
                           ../Lib/AI_Runtime/Npu/Devices/STM32N6XX)

target_sources(app PRIVATE ../Lib/AI_Runtime/Npu/ll_aton/ll_aton.c
               ../Lib/AI_Runtime/Npu/ll_aton/ll_aton_osal_zephyr.c
               ../Lib/AI_Runtime/Npu/ll_aton/ll_aton_debug.c
               ../Lib/AI_Runtime/Npu/ll_aton/ll_aton_lib.c
               ../Lib/AI_Runtime/Npu/ll_aton/ll_aton_lib_sw_operators.c
               ../Lib/AI_Runtime/Npu/ll_aton/ll_aton_rt_main.c
               ../Lib/AI_Runtime/Npu/ll_aton/ll_aton_runtime.c
               ../Lib/AI_Runtime/Npu/ll_aton/ll_aton_util.c
               ../Lib/AI_Runtime/Npu/ll_aton/ll_sw_float.c
               ../Lib/AI_Runtime/Npu/ll_aton/ll_sw_integer.c
               ../Lib/AI_Runtime/Npu/ll_aton/ecloader.c
               ../Lib/AI_Runtime/Npu/Devices/STM32N6XX/npu_cache.c
               ../Lib/AI_Runtime/Npu/Devices/STM32N6XX/mcu_cache.c)

target_link_directories(app PUBLIC ../Lib/AI_Runtime/Lib/GCC/ARMCortexM55)

target_link_libraries(app PRIVATE :NetworkRuntime1020_CM55_GCC.a)
```

## prj.conf
```kconfig
# Copyright (c) 2025 STMicroelectronics
# All rights reserved.

CONFIG_MY_APP=y
CONFIG_MAIN_STACK_SIZE=8192
# CONFIG_XIP is not set

CONFIG_USE_STM32_MW_ISP=y
CONFIG_DYNAMIC_INTERRUPTS=y
CONFIG_FLASH=y
CONFIG_HW_STACK_PROTECTION=y
CONFIG_GPIO=y
CONFIG_SERIAL=y
CONFIG_LOG=y
# Temporary disable assertions due to https://github.com/zephyrproject-rtos/zephyr/issues/97904
CONFIG_ASSERT=n
CONFIG_CONSOLE=y
CONFIG_UART_CONSOLE=y

# -------------------------
# Display / Video
# -------------------------
CONFIG_DISPLAY=y
CONFIG_STM32_MEMMAP=y
CONFIG_VIDEO=y
CONFIG_VIDEO_BUFFER_POOL_NUM_MAX=4
CONFIG_VIDEO_STM32_DCMIPP_SENSOR_WIDTH=2592
CONFIG_VIDEO_STM32_DCMIPP_SENSOR_HEIGHT=1944
CONFIG_VIDEO_STM32_DCMIPP_SENSOR_PIXEL_FORMAT="pRAA"

# -------------------------
# LVGL
# -------------------------
CONFIG_LVGL=y

# Keep your minimal lv_conf if your project relies on it
# CONFIG_LV_CONF_MINIMAL=y
CONFIG_LV_USE_CANVAS=y
CONFIG_LV_USE_THEME_DEFAULT=y

# Font you use explicitly
CONFIG_LV_FONT_UNSCII_16=y

# LVGL memory pools (yours was far too small for canvas + widgets)
CONFIG_LV_Z_MEM_POOL_SIZE=131072

# Also ensure Zephyr heap exists for subsystems (FS, logging, etc.)
CONFIG_HEAP_MEM_POOL_SIZE=262144
CONFIG_MULTI_HEAP=y
CONFIG_MEM_ATTR_HEAP=y

# -------------------------
# Touch / Input (for button clicks)
# -------------------------
CONFIG_INPUT=y

# If your touch controller is on I2C (typical on DK boards)
CONFIG_I2C=y

# -------------------------
# CPU / MPU / misc
# -------------------------
CONFIG_ARM_MPU=y
CONFIG_CPU_LOAD=y

# To be sure LOGGER can still output message move this one priority level above main thread
CONFIG_LOG_PROCESS_THREAD_CUSTOM_PRIORITY=y
CONFIG_LOG_PROCESS_THREAD_PRIORITY=13

# -------------------------
# Disk + filesystem
# -------------------------
CONFIG_FILE_SYSTEM=y
CONFIG_FAT_FILESYSTEM_ELM=y

CONFIG_DISK_ACCESS=y
CONFIG_DISK_DRIVER_SDMMC=y

CONFIG_FS_FATFS_LFN=y
CONFIG_FS_FATFS_MAX_LFN=255
```

## src/main.c
```c
/**
 ******************************************************************************
 * @file    main.c
 * @author  GPM Application Team
 *
 ******************************************************************************
 * @attention
 *
 * Copyright (c) 2025 STMicroelectronics.
 * All rights reserved.
 *
 * This software is licensed under terms that can be found in the LICENSE file
 * in the root directory of this software component.
 * If no LICENSE file comes with this software, it is provided AS-IS.
 *
 ******************************************************************************
 */

#include <zephyr/kernel.h>
#include <zephyr/debug/cpu_load.h>
#include <zephyr/drivers/video.h>
#include <zephyr/drivers/display.h>
#include <zephyr/sys/__assert.h>
#include <zephyr/logging/log.h>
#include <zephyr/sys/util.h>
#include <zephyr/input/input.h>
#include <zephyr/sys/atomic.h>

#include <lvgl.h>
#include <font/lv_font.h>
#include <lvgl_mem.h>
#include <lvgl_zephyr.h>

#include <stdarg.h>

#include "model.h"
#include "utils.h"

#include <zephyr/storage/disk_access.h>
#include <zephyr/logging/log.h>
#include <zephyr/data/json.h>

#include <zephyr/fs/fs.h>
#include <ff.h>

LOG_MODULE_REGISTER(main);

#define DISPLAY_WIDTH DT_PROP(DT_CHOSEN(zephyr_display), width)
#define DISPLAY_HEIGHT DT_PROP(DT_CHOSEN(zephyr_display), height)
#define DISPLAY_BPP 2

#define NN_WIDTH CONFIG_NPU_WIDTH
#define NN_HEIGHT CONFIG_NPU_HEIGHT
#define NN_BPP 3
#define NPU_BUFFER_POOL_ALIGN 32

static struct k_thread nn_thread;
static K_THREAD_STACK_DEFINE(nn_thread_stack, 4096);

#if defined(CONFIG_DISK_DRIVER_MMC)
#define DISK_DRIVE_NAME "SD2"
#else
#define DISK_DRIVE_NAME "SD"
#endif

#define DISK_MOUNT_PT "/" DISK_DRIVE_NAME ":"

static FATFS fat_fs;

static struct fs_mount_t mp = {
	.type = FS_FATFS,
	.fs_data = &fat_fs,
	.storage_dev = (void *)DISK_DRIVE_NAME,
	.mnt_point = DISK_MOUNT_PT,
};

static int img_with_gt = 0;
static int img_with_pred = 0;
static int gt_matched = 0;
static int pred_matched = 0;

static int bench_total = 0;
static int bench_done = 0;
static int bench_errors = 0;

static int bench_last_ms = 0;
static int bench_min_ms = 0x7fffffff;
static int bench_max_ms = 0;
static int64_t bench_sum_ms = 0;
static int bench_samples = 0;
static uint16_t canvas_fb[DISPLAY_WIDTH * DISPLAY_HEIGHT];
static struct video_buffer *sd_vbuf;

void nn_init();
void run_nn_from_sd_card(uint8_t *image);

/* Semaphore signaled on evt->sync */
K_SEM_DEFINE(sync, 0, 1);

static int display_setup(const struct device *const display_dev)
{
	int ret;

	ret = display_set_pixel_format(display_dev, PIXEL_FORMAT_RGB_565);
	__ASSERT_NO_MSG(ret == 0);

	ret = display_blanking_off(display_dev);
	__ASSERT_NO_MSG(ret == 0);

	return 0;
}

static void print_text(lv_layer_t *layer, int x, int y, lv_text_align_t align, char *fmt, ...)
{
	lv_draw_label_dsc_t tdsc;
	char text_buffer[128];
	lv_area_t coords;
	va_list ap;

	va_start(ap, fmt);
	vsnprintf(text_buffer, sizeof(text_buffer), fmt, ap);

	/* shadow */
	lv_draw_label_dsc_init(&tdsc);
	tdsc.color = lv_color_make(16, 16, 16);
	tdsc.font = &lv_font_unscii_16;
	coords.x1 = x + 1;
	coords.y1 = y + 1;
	coords.x2 = DISPLAY_WIDTH;
	coords.y2 = DISPLAY_HEIGHT;
	tdsc.text = text_buffer;
	tdsc.text_local = 1;
	tdsc.align = align;
	lv_draw_label(layer, &tdsc, &coords);

	/* text */
	tdsc.color = lv_color_make(255, 255, 255);
	coords.x1 = x;
	coords.y1 = y;
	lv_draw_label(layer, &tdsc, &coords);
	va_end(ap);
}

static void decorate_canvas(lv_obj_t *canvas)
{
	int latest_inference_time = model_get_latest_inference_time();
	const lv_font_t *font = &lv_font_unscii_16;
	lv_draw_rect_dsc_t rdsc;
	struct dbox boxes[10];
	lv_area_t coords;
	lv_layer_t layer;
	struct dbox *b;
	uint32_t ver;
	int load;
	int nb;
	int i;

	ver = sys_kernel_version_get();
	nb = model_get_boxes(boxes, ARRAY_SIZE(boxes));

	lv_canvas_init_layer(canvas, &layer);
	/* Draw banner */
	print_text(&layer, 0, 0, LV_TEXT_ALIGN_CENTER, "People Detection demo");
	print_text(&layer, 0, font->line_height, LV_TEXT_ALIGN_CENTER, "Powered by zephyr OS %d.%d.%d",
			   SYS_KERNEL_VER_MAJOR(ver), SYS_KERNEL_VER_MINOR(ver), SYS_KERNEL_VER_PATCHLEVEL(ver));

	/* Draw inference time */
	print_text(&layer, 0, DISPLAY_HEIGHT - font->line_height * 3, LV_TEXT_ALIGN_LEFT, "Inference %d ms",
			   latest_inference_time);
	latest_inference_time = latest_inference_time ? latest_inference_time : 1;
	print_text(&layer, 0, DISPLAY_HEIGHT - font->line_height * 2, LV_TEXT_ALIGN_LEFT, "Fps       %d",
			   1000 / latest_inference_time);
#ifdef CONFIG_CPU_LOAD
	load = cpu_load_get(1);
	print_text(&layer, 0, DISPLAY_HEIGHT - font->line_height * 1, LV_TEXT_ALIGN_LEFT, "cpu load  %d.%d%%",
			   load / 10, load % 10);
#else
	(void)load;
#endif

	/* Draw boxes */
	lv_draw_rect_dsc_init(&rdsc);
	rdsc.border_color = lv_palette_main(LV_PALETTE_GREEN);
	rdsc.border_width = 2;
	rdsc.radius = 10;
	rdsc.bg_opa = 0;
	for (i = 0; i < nb; i++)
	{
		b = &boxes[i];
		coords.x1 = b->x;
		coords.y1 = b->y;
		coords.x2 = b->x + b->w;
		coords.y2 = b->y + b->h;
		lv_draw_rect(&layer, &rdsc, &coords);
	}

	lv_canvas_finish_layer(canvas, &layer);
}

static void draw_progress_bar(lv_layer_t *layer, int x, int y, int w, int h, float percent)
{
	lv_draw_rect_dsc_t box, fill;
	lv_area_t a;

	if (percent < 0)
		percent = 0;
	if (percent > 100)
		percent = 100;

	lv_draw_rect_dsc_init(&box);
	box.border_width = 2;
	box.border_color = lv_color_white();
	box.radius = 6;
	box.bg_opa = LV_OPA_10;

	a.x1 = x;
	a.y1 = y;
	a.x2 = x + w;
	a.y2 = y + h;
	lv_draw_rect(layer, &box, &a);

	lv_draw_rect_dsc_init(&fill);
	fill.radius = 6;
	fill.bg_opa = LV_OPA_COVER;
	fill.bg_color = lv_palette_main(LV_PALETTE_BLUE);
	fill.border_width = 0;

	int fw = (int)((w - 4) * (percent / 100.0f));
	if (fw < 0)
		fw = 0;
	a.x1 = x + 2;
	a.y1 = y + 2;
	a.x2 = x + 2 + fw;
	a.y2 = y + h - 2;
	if (a.x2 > a.x1)
	{
		lv_draw_rect(layer, &fill, &a);
	}
}

static void clear_canvas(lv_obj_t *canvas)
{
	/* Fast clear to black (change to lv_color_white() if you want) */
	lv_canvas_fill_bg(canvas, lv_color_black(), LV_OPA_COVER);
}

static void decorate_benchmark(lv_obj_t *canvas, float percent)
{
	clear_canvas(canvas);

	const lv_font_t *font = &lv_font_unscii_16;
	lv_layer_t layer;
	uint32_t ver = sys_kernel_version_get();
	int load = 0;

	lv_canvas_init_layer(canvas, &layer);

	print_text(&layer, 0, 0, LV_TEXT_ALIGN_CENTER, "Benchmark: YOLOv2");
	print_text(&layer, 0, font->line_height, LV_TEXT_ALIGN_CENTER,
			   "Zephyr %d.%d.%d", SYS_KERNEL_VER_MAJOR(ver), SYS_KERNEL_VER_MINOR(ver), SYS_KERNEL_VER_PATCHLEVEL(ver));

	/* Progress bar */
	int bar_w = DISPLAY_WIDTH - 40;
	int bar_h = 18;
	int bar_x = 20;
	int bar_y = font->line_height * 3;
	draw_progress_bar(&layer, bar_x, bar_y, bar_w, bar_h, percent);

	print_text(&layer, 0, bar_y + bar_h + 4, LV_TEXT_ALIGN_CENTER,
			   "%d / %d (%.1f%%)", bench_done, bench_total, (double)percent);

	/* Latency stats */
	int avg = (bench_samples > 0) ? (int)(bench_sum_ms / bench_samples) : 0;
	int fps = (bench_last_ms > 0) ? (1000 / bench_last_ms) : 0;

	int y0 = DISPLAY_HEIGHT - font->line_height * 6;
	print_text(&layer, 0, y0 + font->line_height * 0, LV_TEXT_ALIGN_LEFT,
			   "Last: %d ms  (%d FPS)", bench_last_ms, fps);
	print_text(&layer, 0, y0 + font->line_height * 1, LV_TEXT_ALIGN_LEFT,
			   "Avg : %d ms", avg);
	print_text(&layer, 0, y0 + font->line_height * 2, LV_TEXT_ALIGN_LEFT,
			   "Min : %d ms   Max: %d ms", (bench_min_ms == 0x7fffffff) ? 0 : bench_min_ms, bench_max_ms);

#ifdef CONFIG_CPU_LOAD
	load = cpu_load_get(1);
	print_text(&layer, 0, y0 + font->line_height * 3, LV_TEXT_ALIGN_LEFT,
			   "CPU : %d.%d%%", load / 10, load % 10);
#endif

	/* Your existing detection benchmark counters */
	print_text(&layer, 0, y0 + font->line_height * 4, LV_TEXT_ALIGN_LEFT,
			   "GT:%d  Pred:%d  MatchGT:%d  MatchPred:%d",
			   img_with_gt, img_with_pred, gt_matched, pred_matched);

	lv_canvas_finish_layer(canvas, &layer);
}

static int video_crop_setup(const struct device *const video_dev, uint32_t sensor_width, uint32_t sensor_height)
{
	const float ratioy = (float)sensor_height / DISPLAY_HEIGHT;
	const float ratiox = (float)sensor_width / DISPLAY_WIDTH;
	const float ratio = MIN(ratiox, ratioy);
	struct video_selection crop = {
		.type = VIDEO_BUF_TYPE_OUTPUT,
	};
	int ret;

	__ASSERT_NO_MSG(ratio >= 1);
	__ASSERT_NO_MSG(ratio < 64);

	crop.target = VIDEO_SEL_TGT_CROP;
	crop.rect.width = DISPLAY_WIDTH * ratio;
	crop.rect.height = DISPLAY_HEIGHT * ratio;
	crop.rect.left = (sensor_width - crop.rect.width + 1) / 2;
	crop.rect.top = (sensor_height - crop.rect.height + 1) / 2;

	ret = video_set_selection(video_dev, &crop);
	__ASSERT_NO_MSG(ret == 0);

	return 0;
}

static int video_resize_setup(const struct device *const video_dev, uint32_t width, uint32_t height)
{
	struct video_selection comp = {
		.type = VIDEO_BUF_TYPE_OUTPUT,
	};
	int ret;

	comp.target = VIDEO_SEL_TGT_COMPOSE;
	comp.rect.left = 0;
	comp.rect.top = 0;
	comp.rect.width = width;
	comp.rect.height = height;

	ret = video_set_selection(video_dev, &comp);
	__ASSERT_NO_MSG(ret == 0);

	return 0;
}

static int video_alloc_and_queue_buffers(const struct device *const video_dev, size_t bsize, int align)
{
	struct video_buffer *buffers[2];
	int ret;
	int i;

	for (i = 0; i < ARRAY_SIZE(buffers); i++)
	{
		buffers[i] = video_buffer_aligned_alloc(bsize, align, K_FOREVER);
		__ASSERT_NO_MSG(buffers[i]);
		buffers[i]->type = VIDEO_BUF_TYPE_OUTPUT;
		ret = video_enqueue(video_dev, buffers[i]);
		__ASSERT_NO_MSG(ret == 0);
		LOG_INF("buffer %p(%p) queue to %s pipe", (void *)buffers[i], (void *)buffers[i]->buffer, video_dev->name);
	}

	return 0;
}

static int video_main_setup(const struct device *const video_dev, uint32_t sensor_width, uint32_t sensor_height)
{
	struct video_format fmt;
	size_t bsize;
	int ret;

	/* setup crop, compose and output */
	ret = video_crop_setup(video_dev, sensor_width, sensor_height);
	__ASSERT_NO_MSG(ret == 0);
	ret = video_resize_setup(video_dev, DISPLAY_WIDTH, DISPLAY_HEIGHT);
	__ASSERT_NO_MSG(ret == 0);
	fmt.pixelformat = VIDEO_FOURCC_FROM_STR("RGBP");
	fmt.width = DISPLAY_WIDTH;
	fmt.height = DISPLAY_HEIGHT;
	fmt.pitch = fmt.width * DISPLAY_BPP;
	ret = video_set_format(video_dev, &fmt);
	__ASSERT_NO_MSG(ret == 0);

	/* alloc buffers and queue them */
	bsize = fmt.pitch * fmt.height;
	ret = video_alloc_and_queue_buffers(video_dev, bsize, CONFIG_VIDEO_BUFFER_POOL_ALIGN);
	__ASSERT_NO_MSG(ret == 0);

	return 0;
}

static int video_aux_setup(const struct device *const video_dev, uint32_t sensor_width, uint32_t sensor_height)
{
	struct video_format fmt;
	size_t bsize;
	int ret;

	/* setup crop, compose and output */
	ret = video_crop_setup(video_dev, sensor_width, sensor_height);
	__ASSERT_NO_MSG(ret == 0);
	ret = video_resize_setup(video_dev, NN_WIDTH, NN_HEIGHT);
	__ASSERT_NO_MSG(ret == 0);
	fmt.pixelformat = VIDEO_FOURCC_FROM_STR("RGB3");
	fmt.width = NN_WIDTH;
	fmt.height = NN_HEIGHT;
	fmt.pitch = fmt.width * NN_BPP;
	ret = video_set_format(video_dev, &fmt);
	__ASSERT_NO_MSG(ret == 0);

	/* alloc buffers and queue them */
	bsize = fmt.pitch * fmt.height;
	ret = video_alloc_and_queue_buffers(video_dev, bsize, NPU_BUFFER_POOL_ALIGN);
	__ASSERT_NO_MSG(ret == 0);

	return 0;
}

static int video_setup(const struct device *const main_dev, const struct device *const aux_dev)
{
	struct video_format fmt;
	uint32_t sensor_height;
	uint32_t sensor_width;
	int ret;

	/* get default format to get sensor width / height */
	ret = video_get_format(main_dev, &fmt);
	__ASSERT_NO_MSG(ret == 0);
	sensor_height = fmt.height;
	sensor_width = fmt.width;

	ret = video_main_setup(main_dev, sensor_width, sensor_height);
	__ASSERT_NO_MSG(ret == 0);

	ret = video_aux_setup(aux_dev, sensor_width, sensor_height);
	__ASSERT_NO_MSG(ret == 0);

	return 0;
}

static int run_benchmark_on_sd_card(const char *path, lv_obj_t *canvas)
{
	int res;
	struct fs_dir_t dirp;
	static struct fs_dirent entry;
	int count = 0;
	bench_total = count_csv_lines("/SD:/benchmark_224.csv");
	if (bench_total <= 0)
	{
		LOG_ERR("No files found for benchmark");
		return 0;
	}

	fs_dir_t_init(&dirp);

	/* Verify fs_opendir() */
	res = fs_opendir(&dirp, path);
	if (res)
	{
		LOG_INF("Error opening dir %s [%d]", path, res);
		return res;
	}

	LOG_INF("\nListing dir %s ...", path);
	for (;;)
	{
		/* Verify fs_readdir() */
		res = fs_readdir(&dirp, &entry);

		/* entry.name[0] == 0 means end-of-dir */
		if (res || entry.name[0] == 0)
		{
			break;
		}

		if (entry.type == FS_DIR_ENTRY_DIR)
		{
			LOG_INF("[DIR ] %s", entry.name);
		}
		else
		{
			LOG_INF("[FILE] %s (size = %zu)",
					entry.name, entry.size);
			ssize_t bytes;
			struct fs_file_t file;
			int ret;

			fs_file_t_init(&file);

			char full_path[256];
			snprintf(full_path, sizeof(full_path), "%s/%s", path, entry.name);

			ret = fs_open(&file, full_path, FS_O_READ);
			if (ret < 0)
			{
				LOG_ERR("fs_open(%s) failed (%d)", full_path, ret);
				return ret;
			}

			bytes = fs_read(&file, sd_vbuf->buffer, NN_HEIGHT * NN_WIDTH * NN_BPP);
			__ASSERT_NO_MSG(bytes == NN_HEIGHT * NN_WIDTH * NN_BPP);

			run_nn_from_sd_card(sd_vbuf->buffer);

			fs_close(&file);
			struct gt_boxes gt = {0};
			int gr = gt_find_person_boxes_csv("/SD:/benchmark_224.csv", entry.name, &gt);
			if (gr < 0)
			{
				LOG_WRN("GT lookup error %d for %s", gr, entry.name);
				continue;
			}

			struct dbox preds[10];
			int n_pred = model_get_boxes(preds, ARRAY_SIZE(preds));

			LOG_INF("Detection for annotations: %d", gt.count);
			if (gt.count > 0)
			{
				LOG_INF("GT0: x=%.1f y=%.1f w=%.1f h=%.1f", gt.xywh[0][0], gt.xywh[0][1], gt.xywh[0][2], gt.xywh[0][3]);
			}
			if (n_pred > 0)
			{
				LOG_INF("P0 : x=%d y=%d w=%d h=%d", preds[0].x, preds[0].y, preds[0].w, preds[0].h);
			}

			bool has_pred = (n_pred > 0);
			bool has_gt = (gt.count > 0);

			if (has_gt)
				img_with_gt++;
			if (has_pred)
				img_with_pred++;

			bool matched = false;
			if (has_gt && has_pred)
			{
				for (int gi = 0; gi < gt.count && !matched; gi++)
				{
					struct box_xyxy g = xywh_to_xyxy(gt.xywh[gi][0], gt.xywh[gi][1],
													 gt.xywh[gi][2], gt.xywh[gi][3]);
					for (int pi = 0; pi < n_pred; pi++)
					{
						struct box_xyxy p = dbox_to_xyxy(&preds[pi]);
						if (iou_xyxy(g, p) >= 0.5f)
						{ // IOU_THRESH
							matched = true;
							break;
						}
					}
				}
			}

			if (matched)
			{
				gt_matched++;
				pred_matched++;
			}
		}
		count++;
		bench_last_ms = model_get_latest_inference_time();
		if (bench_last_ms > 0)
		{
			bench_min_ms = MIN(bench_min_ms, bench_last_ms);
			bench_max_ms = MAX(bench_max_ms, bench_last_ms);
			bench_sum_ms += bench_last_ms;
			bench_samples++;
		}
		else
		{
			bench_errors++;
		}
		bench_done = count;

		float percent = 100.0f * (float)count / (float)bench_total;
		decorate_benchmark(canvas, percent);
		lv_timer_handler();
		k_sleep(K_MSEC(5));

	}
	LOG_INF("END OF BENCHMARK");

	/* Verify fs_closedir() */
	fs_closedir(&dirp);
	if (res == 0)
	{
		res = count;
	}

	LOG_INF("Images with GT person   : %d", img_with_gt);
	LOG_INF("Images with predictions : %d", img_with_pred);
	LOG_INF("GT matched images       : %d", gt_matched);
	LOG_INF("Pred matched images     : %d", pred_matched);

	if (img_with_gt)
	{
		LOG_INF("Recall  : %d/%d = %d.%02d",
				gt_matched, img_with_gt,
				(gt_matched * 100) / img_with_gt,
				((gt_matched * 10000) / img_with_gt) % 100);
	}
	if (img_with_pred)
	{
		LOG_INF("Prec    : %d/%d = %d.%02d",
				pred_matched, img_with_pred,
				(pred_matched * 100) / img_with_pred,
				((pred_matched * 10000) / img_with_pred) % 100);
	}

	return res;
}
static bool pressed;

static void button_input_cb(struct input_event *evt, void *user_data)
{
	if (evt->sync == 0)
	{
		return;
	}

	if (evt->value == 0)
	{
		LOG_INF("Button released - Benchmark started!!!!");
		pressed = 1;
	}
}

INPUT_CALLBACK_DEFINE(NULL, button_input_cb, NULL);

int main()
{
	const struct device *const display_dev = DEVICE_DT_GET(DT_CHOSEN(zephyr_display));
	lv_obj_t *canvas;
	k_tid_t nn_tid;
	int ret;

	__ASSERT_NO_MSG(device_is_ready(display_dev));

	/* Configure display */
	ret = display_setup(display_dev);
	__ASSERT_NO_MSG(ret == 0);

	nn_init();
	sd_vbuf = video_buffer_aligned_alloc(NN_HEIGHT * NN_WIDTH * NN_BPP, 32, K_FOREVER);
	__ASSERT_NO_MSG(sd_vbuf && sd_vbuf->buffer);

	canvas = lv_canvas_create(lv_scr_act());
	lv_canvas_set_buffer(canvas, canvas_fb, DISPLAY_WIDTH, DISPLAY_HEIGHT, LV_COLOR_FORMAT_RGB565);
	lv_canvas_fill_bg(canvas, lv_color_black(), LV_OPA_COVER); /* optional */

	lv_obj_t *start_label = lv_label_create(lv_scr_act());
	lv_label_set_text(start_label,
					  "Press Button 'USER 1' to start benchmark");
	lv_obj_set_width(start_label, DISPLAY_WIDTH - 20);

	/* Match print_text() font and alignment */
	lv_obj_set_style_text_font(start_label, &lv_font_unscii_16, 0);
	lv_obj_set_style_text_align(start_label, LV_TEXT_ALIGN_CENTER, 0);

	lv_obj_align(start_label, LV_ALIGN_CENTER, 0, 0);

	while (!pressed)
	{
		lv_timer_handler();
		k_sleep(K_MSEC(10));
	}

	lv_obj_del(start_label);
	lv_timer_handler(); /* flush deletion */

	mp.mnt_point = DISK_MOUNT_PT;

	LOG_INF("Mount point configured as: %s", mp.mnt_point);

	int res = fs_mount(&mp);
	LOG_INF("fs_mount res=%d", res);
	if (res != FR_OK)
	{
		LOG_ERR("Mount failed");
		return 0;
	}
	const char *dir_path = "/SD:/BIN_224";

	run_benchmark_on_sd_card(dir_path, canvas);

	return 0;
}
```

## inc/app_config.h
```c
/**
******************************************************************************
* @file    app_config.h
* @author  GPM Application Team
*
******************************************************************************
* @attention
*
* Copyright (c) 2023 STMicroelectronics.
* All rights reserved.
*
* This software is licensed under terms that can be found in the LICENSE file
* in the root directory of this software component.
* If no LICENSE file comes with this software, it is provided AS-IS.
*
******************************************************************************
*/

/* ---------------    Generated code    ----------------- */
#ifndef APP_CONFIG
#define APP_CONFIG

#include "arm_math.h"

#define USE_DCACHE

/*Defines: CMW_MIRRORFLIP_NONE; CMW_MIRRORFLIP_FLIP; CMW_MIRRORFLIP_MIRROR; CMW_MIRRORFLIP_FLIP_MIRROR;*/
#define CAMERA_FLIP CMW_MIRRORFLIP_NONE

#define ASPECT_RATIO_CROP (1) /* Crop both pipes to nn input aspect ratio; Original aspect ratio kept */
#define ASPECT_RATIO_FIT (2) /* Resize both pipe to NN input aspect ratio; Original aspect ratio not kept */
#define ASPECT_RATIO_FULLSCREEN (3) /* Resize camera image to NN input size and display a fullscreen image */
#define ASPECT_RATIO_MODE ASPECT_RATIO_CROP

/* Postprocessing type configuration */
#define POSTPROCESS_TYPE    POSTPROCESS_OD_YOLO_V8_UI

#define NN_HEIGHT     (224)
#define NN_WIDTH      (224)

#define COLOR_BGR (0)
#define COLOR_RGB (1)
#define COLOR_MODE COLOR_RGB
/* Classes */
#define NB_CLASSES   (1)
#define CLASSES_TABLE const char* classes_table[NB_CLASSES] = {\
   "person"}\

/* Postprocessing YOLO_V8 configuration */
#define AI_OD_YOLOV8_PP_NB_CLASSES        (1)
#define AI_OD_YOLOV8_PP_TOTAL_BOXES       (3549)
#define AI_OD_YOLOV8_PP_MAX_BOXES_LIMIT   (10)
#define AI_OD_YOLOV8_PP_CONF_THRESHOLD    (0.5)
#define AI_OD_YOLOV8_PP_IOU_THRESHOLD     (0.5)

#define AI_OD_ST_YOLOX_PP_NB_ANCHORS        (1)

#define WELCOME_MSG_1         "Benchmark"
#define WELCOME_MSG_2       "Model Running in STM32 MCU internal memory"
#endif
```

## inc/model.h
```c
/**
 ******************************************************************************
 * @file    model.h
 * @author  GPM Application Team
 *
 ******************************************************************************
 * @attention
 *
 * Copyright (c) 2025 STMicroelectronics.
 * All rights reserved.
 *
 * This software is licensed under terms that can be found in the LICENSE file
 * in the root directory of this software component.
 * If no LICENSE file comes with this software, it is provided AS-IS.
 *
 ******************************************************************************
 */


#ifndef __MODEL__
#define __MODEL__

struct dbox {
	/* upper left coord */
	int x;
	int y;
	int w;
	int h;
};

int model_get_boxes(struct dbox *boxes, int boxes_nb);
int model_get_latest_inference_time(void);

#endif
```

## inc/utils.h
```c
/**
 ******************************************************************************
 * @file    utils.h
 * @author  GPM Application Team
 *
 ******************************************************************************
 * @attention
 *
 * Copyright (c) 2025 STMicroelectronics.
 * All rights reserved.
 *
 * This software is licensed under terms that can be found in the LICENSE file
 * in the root directory of this software component.
 * If no LICENSE file comes with this software, it is provided AS-IS.
 *
 ******************************************************************************
 */

#ifndef APP_UTILS_H
#define APP_UTILS_H

#include "model.h"

#define MAX_GT_BOXES 64

struct gt_boxes {
	int count;
	float xywh[MAX_GT_BOXES][4];
};

struct box_xyxy {
	float x0, y0, x1, y1;
};

static inline struct box_xyxy xywh_to_xyxy(float x, float y, float w, float h)
{
	struct box_xyxy b = {x, y, x + w, y + h};
	return b;
}

static inline struct box_xyxy dbox_to_xyxy(const struct dbox *b)
{
	struct box_xyxy o = {b->x, b->y, b->x + b->w, b->y + b->h};
	return o;
}

void rstrip(char *s);
void lskip(char **ps);
float iou_xyxy(struct box_xyxy a, struct box_xyxy b);
int gt_find_person_boxes_csv(const char *csv_path, const char *filename, struct gt_boxes *out);
int count_files_in_dir(const char *path);
int count_csv_lines(const char *csv_path);

#endif /* APP_UTILS_H */
```

## src/main_smaller.c
```c
/**
 ******************************************************************************
 * @file    main.c
 * @author  GPM Application Team
 *
 ******************************************************************************
 * @attention
 *
 * Copyright (c) 2025 STMicroelectronics.
 * All rights reserved.
 *
 * This software is licensed under terms that can be found in the LICENSE file
 * in the root directory of this software component.
 * If no LICENSE file comes with this software, it is provided AS-IS.
 *
 ******************************************************************************
 */

#include <zephyr/kernel.h>
#include <zephyr/debug/cpu_load.h>
#include <zephyr/drivers/video.h>
#include <zephyr/drivers/display.h>
#include <zephyr/sys/__assert.h>
#include <zephyr/logging/log.h>
#include <zephyr/sys/util.h>

#include <lvgl.h>
#include <font/lv_font.h>

#include <stdarg.h>

#include "model.h"

LOG_MODULE_REGISTER(main);

#define DISPLAY_WIDTH DT_PROP(DT_CHOSEN(zephyr_display), width)
#define DISPLAY_HEIGHT DT_PROP(DT_CHOSEN(zephyr_display), height)
#define DISPLAY_BPP 2

#define NN_WIDTH CONFIG_NPU_WIDTH
#define NN_HEIGHT CONFIG_NPU_HEIGHT
#define NN_BPP 3
#define NPU_BUFFER_POOL_ALIGN 32

static struct k_thread nn_thread;
static K_THREAD_STACK_DEFINE(nn_thread_stack, 4096);

static int display_setup(const struct device *const display_dev)
{
	int ret;

	ret = display_set_pixel_format(display_dev, PIXEL_FORMAT_RGB_565);
	__ASSERT_NO_MSG(ret == 0);

	ret = display_blanking_off(display_dev);
	__ASSERT_NO_MSG(ret == 0);

	return 0;
}

static void print_text(lv_layer_t *layer, int x, int y, lv_text_align_t align, char *fmt, ...)
{
	lv_draw_label_dsc_t tdsc;
	char text_buffer[128];
	lv_area_t coords;
	va_list ap;

	va_start(ap, fmt);
	vsnprintf(text_buffer, sizeof(text_buffer), fmt, ap);

	/* shadow */
	lv_draw_label_dsc_init(&tdsc);
	tdsc.color = lv_color_make(16, 16, 16);
	tdsc.font = &lv_font_unscii_16;
	coords.x1 = x + 1;
	coords.y1 = y + 1;
	coords.x2 = NN_WIDTH;
	coords.y2 = NN_HEIGHT;
	tdsc.text = text_buffer;
	tdsc.text_local = 1;
	tdsc.align = align;
	lv_draw_label(layer, &tdsc, &coords);

	/* text */
	tdsc.color = lv_color_make(255, 255, 255);
	coords.x1 = x;
	coords.y1 = y;
	lv_draw_label(layer, &tdsc, &coords);
	va_end(ap);
}

static void decorate_canvas(lv_obj_t * canvas)
{
	int latest_inference_time = model_get_latest_inference_time();
	const lv_font_t *font = &lv_font_unscii_16;
	lv_draw_rect_dsc_t rdsc;
	struct dbox boxes[10];
	lv_area_t coords;
	lv_layer_t layer;
	struct dbox *b;
	uint32_t ver;
	int load;
	int nb;
	int i;

	ver = sys_kernel_version_get();
	nb = model_get_boxes(boxes, ARRAY_SIZE(boxes));

	lv_canvas_init_layer(canvas, &layer);
	/* Draw banner */
	print_text(&layer, 0, 0, LV_TEXT_ALIGN_CENTER, "People Detection demo");
	print_text(&layer, 0, font->line_height, LV_TEXT_ALIGN_CENTER, "Powered by zephyr OS %d.%d.%d",
		   SYS_KERNEL_VER_MAJOR(ver), SYS_KERNEL_VER_MINOR(ver), SYS_KERNEL_VER_PATCHLEVEL(ver));

	/* Draw inference time */
	print_text(&layer, 0, DISPLAY_HEIGHT - font->line_height * 3, LV_TEXT_ALIGN_LEFT, "Inference %d ms",
		   latest_inference_time);
	latest_inference_time = latest_inference_time ? latest_inference_time : 1;
	print_text(&layer, 0, DISPLAY_HEIGHT - font->line_height * 2, LV_TEXT_ALIGN_LEFT, "Fps       %d",
		   1000 / latest_inference_time);
#ifdef CONFIG_CPU_LOAD
	load = cpu_load_get(1);
	print_text(&layer, 0, DISPLAY_HEIGHT - font->line_height * 1, LV_TEXT_ALIGN_LEFT, "cpu load  %d.%d%%",
		   load / 10, load % 10);
#else
	(void)load;
#endif

	/* Draw boxes */
	lv_draw_rect_dsc_init(&rdsc);
	rdsc.border_color = lv_palette_main(LV_PALETTE_GREEN);
	rdsc.border_width = 2;
	rdsc.radius = 10;
	rdsc.bg_opa = 0;
	for (i = 0; i < nb; i++) {
		b = &boxes[i];
		coords.x1 = b->x;
		coords.y1 = b->y;
		coords.x2 = b->x + b->w;
		coords.y2 = b->y + b->h;
		lv_draw_rect(&layer, &rdsc, &coords);
	}

	lv_canvas_finish_layer(canvas, &layer);
}

static int video_crop_setup(const struct device *const video_dev, uint32_t sensor_width, uint32_t sensor_height)
{
	const float ratioy = (float)sensor_height / NN_HEIGHT;
	const float ratiox = (float)sensor_width / NN_WIDTH;
	const float ratio = MIN(ratiox, ratioy);
	struct video_selection crop = {
		.type = VIDEO_BUF_TYPE_OUTPUT,
	};
	int ret;

	__ASSERT_NO_MSG(ratio >= 1);
	__ASSERT_NO_MSG(ratio < 64);

	crop.target = VIDEO_SEL_TGT_CROP;
	crop.rect.width = NN_WIDTH * ratio;
	crop.rect.height = NN_HEIGHT * ratio;
	crop.rect.left = (sensor_width - crop.rect.width + 1) /2;
	crop.rect.top = (sensor_height - crop.rect.height + 1) / 2;

	ret = video_set_selection(video_dev, &crop);
	__ASSERT_NO_MSG(ret == 0);

	return 0;
}

static int video_resize_setup(const struct device *const video_dev, uint32_t width, uint32_t height)
{
	struct video_selection comp = {
		.type = VIDEO_BUF_TYPE_OUTPUT,
	};
	int ret;

	comp.target = VIDEO_SEL_TGT_COMPOSE;
	comp.rect.left = 0;
	comp.rect.top = 0;
	comp.rect.width = width;
	comp.rect.height = height;

	ret = video_set_selection(video_dev, &comp);
	__ASSERT_NO_MSG(ret == 0);

	return 0;
}

static int video_alloc_and_queue_buffers(const struct device *const video_dev, size_t bsize, int align)
{
	struct video_buffer *buffers[2];
	int ret;
	int i;

	for (i = 0; i < ARRAY_SIZE(buffers); i++) {
		buffers[i] = video_buffer_aligned_alloc(bsize, align, K_FOREVER);
		__ASSERT_NO_MSG(buffers[i]);
		buffers[i]->type = VIDEO_BUF_TYPE_OUTPUT;
		ret = video_enqueue(video_dev, buffers[i]);
		__ASSERT_NO_MSG(ret == 0);
		LOG_INF("buffer %p(%p) queue to %s pipe", (void *)buffers[i], (void *)buffers[i]->buffer, video_dev->name);
	}

	return 0;
}

static int video_main_setup(const struct device *const video_dev, uint32_t sensor_width, uint32_t sensor_height)
{
	struct video_format fmt;
	size_t bsize;
	int ret;

	/* setup crop, compose and output */
	ret = video_crop_setup(video_dev, sensor_width, sensor_height);
	__ASSERT_NO_MSG(ret == 0);
	ret = video_resize_setup(video_dev, NN_WIDTH, NN_HEIGHT);
	__ASSERT_NO_MSG(ret == 0);
	fmt.pixelformat = VIDEO_FOURCC_FROM_STR("RGBP");
	fmt.width = NN_WIDTH;
	fmt.height = NN_HEIGHT;
	fmt.pitch = fmt.width * DISPLAY_BPP;
	ret = video_set_format(video_dev, &fmt);
	__ASSERT_NO_MSG(ret == 0);

	/* alloc buffers and queue them */
	bsize = fmt.pitch * fmt.height;
	ret = video_alloc_and_queue_buffers(video_dev, bsize, CONFIG_VIDEO_BUFFER_POOL_ALIGN);
	__ASSERT_NO_MSG(ret == 0);

	return 0;
}

static int video_aux_setup(const struct device *const video_dev, uint32_t sensor_width, uint32_t sensor_height)
{
	struct video_format fmt;
	size_t bsize;
	int ret;

	/* setup crop, compose and output */
	ret = video_crop_setup(video_dev, sensor_width, sensor_height);
	__ASSERT_NO_MSG(ret == 0);
	ret = video_resize_setup(video_dev, NN_WIDTH, NN_HEIGHT);
	__ASSERT_NO_MSG(ret == 0);
	fmt.pixelformat = VIDEO_FOURCC_FROM_STR("RGB3");
	fmt.width = NN_WIDTH;
	fmt.height = NN_HEIGHT;
	fmt.pitch = fmt.width * NN_BPP;
	ret = video_set_format(video_dev, &fmt);
	__ASSERT_NO_MSG(ret == 0);

	/* alloc buffers and queue them */
	bsize = fmt.pitch * fmt.height;
	ret = video_alloc_and_queue_buffers(video_dev, bsize, NPU_BUFFER_POOL_ALIGN);
	__ASSERT_NO_MSG(ret == 0);

	return 0;
}

static int video_setup(const struct device *const main_dev, const struct device *const aux_dev)
{
	struct video_format fmt;
	uint32_t sensor_height;
	uint32_t sensor_width;
	int ret;

	/* get default format to get sensor width / height */
	ret = video_get_format(main_dev, &fmt);
	__ASSERT_NO_MSG(ret == 0);
	sensor_height = fmt.height;
	sensor_width = fmt.width;

	ret = video_main_setup(main_dev, sensor_width, sensor_height);
	__ASSERT_NO_MSG(ret == 0);

	ret = video_aux_setup(aux_dev, sensor_width, sensor_height);
	__ASSERT_NO_MSG(ret == 0);

	return 0;
}

int main()
{
	const struct device *const camera_aux_dev = DEVICE_DT_GET(DT_CHOSEN(zephyr_camera_aux));
	const struct device *const display_dev = DEVICE_DT_GET(DT_CHOSEN(zephyr_display));
	const struct device *const video_dev = DEVICE_DT_GET(DT_CHOSEN(zephyr_camera));
	struct video_buffer *vbuf;
	lv_obj_t *canvas;
	k_tid_t nn_tid;
	int ret;

	__ASSERT_NO_MSG(device_is_ready(video_dev));
	__ASSERT_NO_MSG(device_is_ready(camera_aux_dev));
	__ASSERT_NO_MSG(device_is_ready(display_dev));

	/* move main thread priority to lowest one so we let others thread a chance to run */
	k_thread_priority_set(k_current_get(), K_LOWEST_APPLICATION_THREAD_PRIO);

	/* create thread for nn process */
	nn_tid = k_thread_create(&nn_thread, nn_thread_stack, K_THREAD_STACK_SIZEOF(nn_thread_stack), model_thread_ep,
				 (void *) camera_aux_dev, NULL, NULL, 0, 0, K_NO_WAIT);
	__ASSERT_NO_MSG(nn_tid);

	/* Configure display */
	ret = display_setup(display_dev);
	__ASSERT_NO_MSG(ret == 0);

	/* Configure video pipe */
	ret = video_setup(video_dev, camera_aux_dev);
	__ASSERT_NO_MSG(ret == 0);

	/* Start main pipe */
	LOG_INF("Starting main pipe");
	ret = video_stream_start(video_dev, VIDEO_BUF_TYPE_OUTPUT);
	__ASSERT_NO_MSG(ret == 0);

	LOG_INF("Starting aux pipe");
	ret = video_stream_start(camera_aux_dev, VIDEO_BUF_TYPE_OUTPUT);
	__ASSERT_NO_MSG(ret == 0);

	LOG_INF("STARTING");

	canvas = lv_canvas_create(lv_scr_act());
	while (1) {
		ret = video_dequeue(video_dev, &vbuf, K_FOREVER);
		__ASSERT_NO_MSG(ret == 0);

		lv_canvas_set_buffer(canvas, vbuf->buffer, NN_WIDTH, NN_HEIGHT, LV_COLOR_FORMAT_RGB565);
		decorate_canvas(canvas);
		lv_timer_handler();

		ret = video_enqueue(video_dev, vbuf);
		__ASSERT_NO_MSG(ret == 0);
	}

	return 0;
}
```

## src/model.c
```c
/**
 ******************************************************************************
 * @file    model.c
 * @author  GPM Application Team
 *
 ******************************************************************************
 * @attention
 *
 * Copyright (c) 2025 STMicroelectronics.
 * All rights reserved.
 *
 * This software is licensed under terms that can be found in the LICENSE file
 * in the root directory of this software component.
 * If no LICENSE file comes with this software, it is provided AS-IS.
 *
 ******************************************************************************
 */

#include "model.h"

#include <zephyr/cache.h>
#include <zephyr/drivers/video.h>
#include <zephyr/logging/log.h>
#include <zephyr/mem_mgmt/mem_attr_heap.h>
#include "app_config.h"

#include "npu_cache.h"
#include "ll_aton_rt_user_api.h"
#include "od_yolov2_pp_if.h"
#include "app_postprocess.h"

#define DISPLAY_WIDTH DT_PROP(DT_CHOSEN(zephyr_display), width)
#define DISPLAY_HEIGHT DT_PROP(DT_CHOSEN(zephyr_display), height)

/* post process conf */
/* post process conf */
#define AI_OD_YOLOV2_PP_CONF_THRESHOLD (0.5)
#define AI_OD_YOLOV2_PP_IOU_THRESHOLD (0.5)
#define AI_OD_YOLOV2_PP_MAX_BOXES_LIMIT (10)
#define AI_OD_YOLOV2_PP_NB_CLASSES (1)
#define AI_OD_YOLOV2_PP_NB_ANCHORS (5)
#define AI_OD_YOLOV2_PP_GRID_WIDTH (7)
#define AI_OD_YOLOV2_PP_GRID_HEIGHT (7)
#define AI_OD_YOLOV2_PP_NB_INPUT_BOXES (AI_OD_YOLOV2_PP_GRID_WIDTH * AI_OD_YOLOV2_PP_GRID_HEIGHT)
static const float32_t AI_OD_YOLOV2_PP_ANCHORS[2 * AI_OD_YOLOV2_PP_NB_ANCHORS] = {
    0.076023, 0.258508,
    0.163031, 0.413531,
    0.234769, 0.702585,
    0.427054, 0.715892,
    0.748154, 0.857092
};

LOG_MODULE_REGISTER(model);

static uint32_t nn_out_len;
static uint32_t nn_in_len;
static uint8_t *nn_out;

LL_ATON_DECLARE_NAMED_NN_INSTANCE_AND_INTERFACE(Default);

/* latest detections and associate mutex */
static od_pp_outBuffer_t pp_detections_buffer[AI_OD_YOLOV2_PP_MAX_BOXES_LIMIT];
static od_pp_outBuffer_t detections[AI_OD_YOLOV2_PP_MAX_BOXES_LIMIT];
static int detections_nb = -1;
static struct k_mutex boxes_lock;

static int latest_inference_time = 0;
static int number_output;
static void *outs[8]; /* adjust if you can have more than 8 outputs */
static int32_t outs_len[8];
static uint32_t nn_in_len;
static od_yolov2_pp_static_param_t pp_params;
static od_yolov2_pp_in_t pp_input;

static void Run_Inference(NN_Instance_TypeDef *network_instance)
{
    LL_ATON_RT_RetValues_t ll_aton_rt_ret;

    do
    {
        /* Execute first/next step of Cube.AI/ATON runtime */
        ll_aton_rt_ret = LL_ATON_RT_RunEpochBlock(network_instance);
        /* Wait for next event */
        if (ll_aton_rt_ret == LL_ATON_RT_WFE)
            LL_ATON_OSAL_WFE();
    } while (ll_aton_rt_ret != LL_ATON_RT_DONE);

    LL_ATON_RT_Reset_Network(network_instance);
}

static void NPUCache_config()
{
    npu_cache_init();
    npu_cache_enable();
}

static void model_npu_init()
{
    NPUCache_config();

    LOG_INF("Npu subsystem ready");
}

static int clamp_point(int *x, int *y)
{
    int xi = *x, yi = *y;

    if (*x < 0)
        *x = 0;
    if (*y < 0)
        *y = 0;
    if (*x >= NN_WIDTH)
        *x = NN_WIDTH - 1;
    if (*y >= NN_HEIGHT)
        *y = NN_HEIGHT - 1;

    return (xi != *x) || (yi != *y);
}

static void convert_length(float32_t wi, float32_t hi, int *wo, int *ho)
{
    *wo = (int)(NN_WIDTH * wi);
    *ho = (int)(NN_HEIGHT * hi);
}

static void convert_point(float32_t xi, float32_t yi, int *xo, int *yo)
{
    *xo = (int)(NN_WIDTH * xi);
    *yo = (int)(NN_HEIGHT * yi);
}

static void model_detection_to_box(od_pp_outBuffer_t *d, struct dbox *b)
{
    int xc, yc;
    int x0, y0;
    int x1, y1;
    int w, h;

    convert_point(d->x_center, d->y_center, &xc, &yc);
    convert_length(d->width, d->height, &w, &h);
    x0 = xc - (w + 1) / 2;
    y0 = yc - (h + 1) / 2;
    x1 = xc + (w + 1) / 2;
    y1 = yc + (h + 1) / 2;
    clamp_point(&x0, &y0);
    clamp_point(&x1, &y1);
    w = x1 - x0 + 1;
    h = y1 - y0 + 1;

    b->x = x0;
    b->y = y0;
    b->w = w;
    b->h = h;
}

int model_get_boxes(struct dbox *boxes, int boxes_nb)
{
    int nb = 0;
    int ret;
    int i;

    /* not yet init */
    if (detections_nb < 0)
        return 0;

    ret = k_mutex_lock(&boxes_lock, K_FOREVER);
    __ASSERT_NO_MSG(ret == 0);

    nb = MIN(boxes_nb, detections_nb);
    for (i = 0; i < nb; i++)
        model_detection_to_box(&detections[i], &boxes[i]);

    ret = k_mutex_unlock(&boxes_lock);
    __ASSERT_NO_MSG(ret == 0);

    return nb;
}

int model_get_latest_inference_time()
{
    return latest_inference_time;
}

void nn_init()
{
    const LL_Buffer_InfoTypeDef *nn_in_info = LL_ATON_Input_Buffers_Info_Default();
    const LL_Buffer_InfoTypeDef *nn_out_info = LL_ATON_Output_Buffers_Info_Default();

    int ret = k_mutex_init(&boxes_lock);
    __ASSERT_NO_MSG(ret == 0);
    detections_nb = 0;

    model_npu_init();

    /* Initialize Cube.AI/ATON ... */
    LL_ATON_RT_RuntimeInit();
    /* ... and model instance */
    LL_ATON_RT_Init_Network(&NN_Instance_Default);

    nn_in_len = LL_Buffer_len(nn_in_info);
    nn_out_len = LL_Buffer_len(nn_out_info);
    nn_out = LL_Buffer_addr_base(nn_out_info);
    __ASSERT_NO_MSG(nn_out);

    /* pp init */
    pp_params.conf_threshold = AI_OD_YOLOV2_PP_CONF_THRESHOLD;
    pp_params.iou_threshold = AI_OD_YOLOV2_PP_IOU_THRESHOLD;
    pp_params.nb_anchors = AI_OD_YOLOV2_PP_NB_ANCHORS;
    pp_params.nb_classes = AI_OD_YOLOV2_PP_NB_CLASSES;
    pp_params.grid_height = AI_OD_YOLOV2_PP_GRID_HEIGHT;
    pp_params.grid_width = AI_OD_YOLOV2_PP_GRID_WIDTH;
    pp_params.nb_input_boxes = AI_OD_YOLOV2_PP_NB_INPUT_BOXES;
    pp_params.pAnchors = AI_OD_YOLOV2_PP_ANCHORS;
    pp_params.max_boxes_limit = AI_OD_YOLOV2_PP_MAX_BOXES_LIMIT;
    ret = od_yolov2_pp_reset(&pp_params);
    __ASSERT_NO_MSG(ret == 0);
    LOG_INF("NN in_len=%u, outputs=%d", nn_in_len, number_output);
}

void run_nn_from_sd_card(uint8_t *image)
{
    od_pp_out_t pp_output;

    sys_cache_data_flush_range(image, nn_in_len);

    int ret = LL_ATON_Set_User_Input_Buffer_Default(0, image, nn_in_len);
    __ASSERT_NO_MSG(ret == LL_ATON_User_IO_NOERROR);

    /* invalidate all outputs before postprocess reads them */
    for (int i = 0; i < number_output; i++)
    {
        sys_cache_data_invd_range(outs[i], outs_len[i]);
    }

    uint32_t t0 = k_uptime_get_32();
    Run_Inference(&NN_Instance_Default);
    uint32_t dt = k_uptime_get_32() - t0;
    latest_inference_time = (int)dt;

    /* NOW invalidate outputs so CPU reads the fresh NPU result */

    for (int i = 0; i < number_output; i++)
    {
        sys_cache_data_invd_range(outs[i], outs_len[i]);
    }

    pp_input.pRaw_detections = (float32_t *)nn_out;
    pp_output.pOutBuff = pp_detections_buffer;
    ret = od_yolov2_pp_process(&pp_input, &pp_output, &pp_params);
    __ASSERT_NO_MSG(ret == 0);

    /* store detections */
    ret = k_mutex_lock(&boxes_lock, K_FOREVER);
    __ASSERT_NO_MSG(ret == 0);

    detections_nb = MIN((int)pp_output.nb_detect, AI_OD_YOLOV8_PP_MAX_BOXES_LIMIT);
    for (int i = 0; i < detections_nb; i++)
    {
        detections[i] = pp_output.pOutBuff[i];
    }

    ret = k_mutex_unlock(&boxes_lock);
    __ASSERT_NO_MSG(ret == 0);

    LOG_INF("Inference=%ums, detected=%d", latest_inference_time, detections_nb);
}
```

## src/npu_cache_hack.c
```c
/**
 ******************************************************************************
 * @file    npu_cache_hack.c
 * @author  GPM Application Team
 *
 ******************************************************************************
 * @attention
 *
 * Copyright (c) 2026 STMicroelectronics.
 * All rights reserved.
 *
 * This software is licensed under terms that can be found in the LICENSE file
 * in the root directory of this software component.
 * If no LICENSE file comes with this software, it is provided AS-IS.
 *
 ******************************************************************************
 */

#include "stm32n6xx_hal.h"

/* 3.0.0 version of ../../Lib/AI_Runtime/Npu/Devices/STM32N6xx/npu_cache.c will not compile in zephyr due bad zephyr
 * hal order.
 * This file add stm32n6xx_hal.h so we include hal tpes before compiling original npu_cache.c.
 */

#include "../../Lib/AI_Runtime/Npu/Devices/STM32N6xx/npu_cache.c"
```

## src/utils.c
```c
/**
 ******************************************************************************
 * @file    utils.c
 * @author  GPM Application Team
 *
 ******************************************************************************
 * @attention
 *
 * Copyright (c) 2025 STMicroelectronics.
 * All rights reserved.
 *
 * This software is licensed under terms that can be found in the LICENSE file
 * in the root directory of this software component.
 * If no LICENSE file comes with this software, it is provided AS-IS.
 *
 ******************************************************************************
 */

#include <zephyr/kernel.h>
#include <zephyr/fs/fs.h>
#include <zephyr/logging/log.h>
#include <zephyr/sys/util.h>

#include <string.h>
#include <stdlib.h>
#include <errno.h>
#include <stdbool.h>

#include "utils.h"

LOG_MODULE_REGISTER(utils);

void rstrip(char *s)
{
	size_t n = strlen(s);
	while (n && (s[n - 1] == '\r' || s[n - 1] == '\n' ||
				 s[n - 1] == ' ' || s[n - 1] == '\t'))
	{
		s[--n] = 0;
	}
}

void lskip(char **ps)
{
	while (**ps == ' ' || **ps == '\t')
	{
		(*ps)++;
	}
}

float iou_xyxy(struct box_xyxy a, struct box_xyxy b)
{
	float x1 = MAX(a.x0, b.x0);
	float y1 = MAX(a.y0, b.y0);
	float x2 = MIN(a.x1, b.x1);
	float y2 = MIN(a.y1, b.y1);

	float w = x2 - x1;
	float h = y2 - y1;
	if (w <= 0.f || h <= 0.f)
		return 0.f;

	float inter = w * h;
	float area_a = MAX(0.f, a.x1 - a.x0) * MAX(0.f, a.y1 - a.y0);
	float area_b = MAX(0.f, b.x1 - b.x0) * MAX(0.f, b.y1 - b.y0);
	if (area_a <= 0.f || area_b <= 0.f)
		return 0.f;

	return inter / (area_a + area_b - inter + 1e-6f);
}

int gt_find_person_boxes_csv(const char *csv_path,
							 const char *filename,
							 struct gt_boxes *out)
{
	struct fs_file_t file;
	fs_file_t_init(&file);

	/* Always initialize output */
	memset(out, 0, sizeof(*out));

	int ret = fs_open(&file, csv_path, FS_O_READ);
	if (ret < 0)
	{
		LOG_ERR("fs_open(%s) failed: %d", csv_path, ret);
		return ret;
	}

	/* Larger buffer to avoid truncating long lines */
	char line[4096];
	size_t pos = 0;
	bool found = false;

	for (;;)
	{
		uint8_t ch;
		ssize_t r = fs_read(&file, &ch, 1);
		if (r <= 0)
		{
			break; /* EOF */
		}

		if (ch == '\n' || pos == sizeof(line) - 1)
		{
			line[pos] = 0;
			pos = 0;

			/* If we hit buffer limit without '\n', the line is truncated.
			 * We'll still parse what we have, but it's likely incomplete.
			 */
			rstrip(line);

			if (line[0] == 0)
			{
				continue;
			}

			/* line: fname,count,x,y,w,h,x,y,w,h,... */
			char *save = NULL;
			char *tok = strtok_r(line, ",", &save);
			if (!tok)
			{
				continue;
			}

			lskip(&tok);
			rstrip(tok);

			if (strcmp(tok, filename) != 0)
			{
				continue;
			}

			/* Matched filename */
			found = true;

			tok = strtok_r(NULL, ",", &save);
			if (!tok)
			{
				fs_close(&file);
				return -EINVAL;
			}
			lskip(&tok);
			rstrip(tok);

			int n = atoi(tok);
			if (n < 0)
				n = 0;
			if (n > MAX_GT_BOXES)
				n = MAX_GT_BOXES;

			for (int i = 0; i < n; i++)
			{
				for (int k = 0; k < 4; k++)
				{
					tok = strtok_r(NULL, ",", &save);
					if (!tok)
					{
						fs_close(&file);
						return -EINVAL;
					}
					lskip(&tok);
					rstrip(tok);
					out->xywh[i][k] = strtof(tok, NULL);
				}
			}

			out->count = n;
			break; /* done */
		}
		else
		{
			line[pos++] = (char)ch;
		}
	}

	fs_close(&file);

	if (!found)
	{
		return -ENOENT; /* not found */
	}
	return 0;
}

int count_files_in_dir(const char *path)
{
	struct fs_dir_t dirp;
	struct fs_dirent entry;
	int count = 0;
	int res;

	fs_dir_t_init(&dirp);

	res = fs_opendir(&dirp, path);
	if (res)
	{
		LOG_ERR("fs_opendir(%s) failed: %d", path, res);
		return res;
	}

	while (1)
	{
		res = fs_readdir(&dirp, &entry);
		if (res || entry.name[0] == 0)
		{
			break; /* end of dir */
		}

		if (entry.type == FS_DIR_ENTRY_FILE)
		{
			count++;
		}
	}

	fs_closedir(&dirp);
	return count;
}

int count_csv_lines(const char *csv_path)
{
	struct fs_file_t file;
	uint8_t ch;
	int lines = 0;
	int ret;

	fs_file_t_init(&file);

	ret = fs_open(&file, csv_path, FS_O_READ);
	if (ret < 0)
	{
		LOG_ERR("fs_open(%s) failed: %d", csv_path, ret);
		return ret;
	}

	while (fs_read(&file, &ch, 1) == 1)
	{
		if (ch == '\n')
		{
			lines++;
		}
	}

	fs_close(&file);
	return lines;
}
```
